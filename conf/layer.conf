## conf/layer.conf
```bitbake
# We have a conf and classes directory, add to BBPATH
BBPATH .= ":${LAYERDIR}"

LAYERSERIES_COMPAT_meta-qt-hello-world = "sumo"

# We have recipes-* directories, add to BBFILES
BBFILES += "${LAYERDIR}/recipes-*/*/*.bb \
            ${LAYERDIR}/recipes-*/*/*.bbappend"

BBFILE_COLLECTIONS += "meta-qt-hello-world"
BBFILE_PATTERN_meta-qt-hello-world = "^${LAYERDIR}/"
BBFILE_PRIORITY_meta-qt-hello-world = "6"

LAYERDEPENDS_meta-qt-hello-world = "core"
LAYERSERIES_COMPAT_meta-qt-hello-world = "dunfell"
```
